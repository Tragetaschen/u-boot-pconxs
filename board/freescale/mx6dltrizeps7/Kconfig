## board/freescale/mx6dltrizeps7/Kconfig
```kconfig
if TARGET_MX6DLTRIZEPS7F500

config SYS_BOARD
	default "mx6dltrizeps7"

config SYS_VENDOR
	default "freescale"

config SYS_SOC
	default "mx6"

config SYS_CONFIG_NAME
	default "mx6dltrizeps7f500"

endif
if TARGET_MX6DLTRIZEPS7PCONXS

config SYS_BOARD
	default "mx6dltrizeps7"

config SYS_VENDOR
	default "freescale"

config SYS_SOC
	default "mx6"

config SYS_CONFIG_NAME
	default "mx6dltrizeps7pconxs"

endif
if TARGET_MX6DLTRIZEPS7U100

config SYS_BOARD
	default "mx6dltrizeps7"

config SYS_VENDOR
	default "freescale"

config SYS_SOC
	default "mx6"

config SYS_CONFIG_NAME
	default "mx6dltrizeps7u100"

endif
```

## board/freescale/mx6dltrizeps7pconxs/Kconfig
```kconfig
if TARGET_MX6DLTRIZEPS7PCONXS

config SYS_CPU
	default "armv7"

config SYS_BOARD
	default "mx6dltrizeps7pconxs"

config SYS_VENDOR
	default "freescale"

config SYS_SOC
	default "mx6"

config SYS_CONFIG_NAME
	default "mx6dltrizeps7pconxs"

endif
```

## board/keith-koep/trizeps_vii_dl/Kconfig
```kconfig
if TARGET_TRIZEPS_VII_DL

config SYS_BOARD
	default "trizeps_vii_dl"

config SYS_VENDOR
	default "keith-koep"

config SYS_CONFIG_NAME
	default "trizeps_vii_dl"

endif
```

## board/keith-koep/trizeps_vii_sx/Kconfig
```kconfig
if TARGET_TRIZEPS_VII_SX

config SYS_BOARD
	default "trizeps_vii_sx"

config SYS_VENDOR
	default "keith-koep"

config SYS_CONFIG_NAME
	default "trizeps_vii_sx"

endif
```

## configs/mx6dltrizeps7f500_defconfig
```kconfig
CONFIG_SYS_EXTRA_OPTIONS="IMX_CONFIG=board/freescale/mx6dltrizeps7/imximage.cfg,MX6DL"
CONFIG_ARM=y
CONFIG_TARGET_MX6DLTRIZEPS7F500=y
```

## configs/mx6dltrizeps7pconxs_defconfig
```kconfig
CONFIG_SYS_EXTRA_OPTIONS="IMX_CONFIG=board/freescale/mx6dltrizeps7pconxs/imximage.cfg,MX6DL"
CONFIG_ARM=y
CONFIG_TARGET_MX6DLTRIZEPS7PCONXS=y
```

## configs/mx6dltrizeps7u100_defconfig
```kconfig
CONFIG_ARM=y
CONFIG_ARCH_MX6=y
CONFIG_TARGET_MX6DLTRIZEPS7U100=y
CONFIG_SYS_EXTRA_OPTIONS="IMX_CONFIG=board/freescale/mx6dltrizeps7/imximage.cfg,MX6DL"
```

## configs/trizeps_vii_dl_defconfig
```kconfig
CONFIG_ARM=y
CONFIG_ARCH_MX6=y
CONFIG_SYS_TEXT_BASE=0x17800000
CONFIG_TARGET_TRIZEPS_VII_DL=y
CONFIG_ENV_SIZE=0x2000
CONFIG_ENV_OFFSET=0x80000
CONFIG_NR_DRAM_BANKS=1
CONFIG_SYS_EXTRA_OPTIONS="IMX_CONFIG=board/keith-koep/trizeps_vii_dl/imximage.cfg"
CONFIG_DEFAULT_DEVICE_TREE="imx6dl-trizeps-vii"

CONFIG_FIT=y
CONFIG_MXC_UART=y
CONFIG_OF_CONTROL=y
CONFIG_HUSH_PARSER=y
CONFIG_SYS_I2C_MXC=y
CONFIG_FSL_ESDHC_IMX=y
CONFIG_FSL_USDHC=y
CONFIG_LED=y
CONFIG_LED_GPIO=y
CONFIG_PINCTRL=y
CONFIG_PINCTRL_IMX6=y
CONFIG_IMX_THERMAL=y

CONFIG_DM_GPIO=y
CONFIG_DM_I2C=y
CONFIG_DM_MMC=y
CONFIG_DM_PMIC=y
CONFIG_DM_REGULATOR=y
CONFIG_DM_PMIC_PFUZE100=y
CONFIG_DM_SERIAL=y

CONFIG_BOOTDELAY=1

CONFIG_CMD_CACHE=y
CONFIG_CMD_GPIO=y
CONFIG_CMD_EXT2=y
CONFIG_CMD_EXT4=y
CONFIG_CMD_EXT4_WRITE=y
CONFIG_CMD_FAT=y
CONFIG_CMD_FS_GENERIC=y
CONFIG_CMD_I2C=y
CONFIG_CMD_MMC=y
CONFIG_CMD_REGULATOR=y

# CONFIG_NET is not set
# CONFIG_EFI_LOADER is not set
```

## configs/trizeps_vii_sx_defconfig
```kconfig
CONFIG_ARM=y
CONFIG_ARCH_MX6=y
CONFIG_TARGET_TRIZEPS_VII_SX=y
CONFIG_SYS_EXTRA_OPTIONS="IMX_CONFIG=board/keith-koep/trizeps_vii_sx/imximage.cfg"
CONFIG_FIT=y
CONFIG_HUSH_PARSER=y
CONFIG_CMD_MEMTEST=y
CONFIG_CMD_BOOTZ=y
# CONFIG_CMD_IMLS is not set
# CONFIG_CMD_FLASH is not set
CONFIG_CMD_MMC=y
CONFIG_CMD_SF=y
CONFIG_CMD_I2C=y
CONFIG_CMD_USB=y
CONFIG_CMD_GPIO=y
# CONFIG_CMD_SETEXPR is not set
CONFIG_CMD_DHCP=y
CONFIG_CMD_MII=y
CONFIG_CMD_PING=y
CONFIG_CMD_CACHE=y
CONFIG_CMD_TIME=y
CONFIG_CMD_EXT2=y
CONFIG_CMD_EXT4=y
CONFIG_CMD_EXT4_WRITE=y
CONFIG_CMD_FAT=y
CONFIG_CMD_FS_GENERIC=y
CONFIG_SPI_FLASH=y
CONFIG_SPI_FLASH_BAR=y
CONFIG_SPI_FLASH_SPANSION=y
CONFIG_OF_LIBFDT=y
CONFIG_BOOTDELAY=1
CONFIG_USB_STORAGE=y
```
